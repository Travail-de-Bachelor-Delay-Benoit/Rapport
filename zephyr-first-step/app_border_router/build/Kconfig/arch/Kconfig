## zephyr-first-step/app_border_router/build/Kconfig/arch/Kconfig
```kconfig
# Load Zephyr Arch Kconfig descriptions.
osource "/home/karilla/Cours/TB/zephyr-first-step/zephyr/arch/rx/Kconfig"
osource "/home/karilla/Cours/TB/zephyr-first-step/zephyr/arch/x86/Kconfig"
osource "/home/karilla/Cours/TB/zephyr-first-step/zephyr/arch/xtensa/Kconfig"
osource "/home/karilla/Cours/TB/zephyr-first-step/zephyr/arch/sparc/Kconfig"
osource "/home/karilla/Cours/TB/zephyr-first-step/zephyr/arch/riscv/Kconfig"
osource "/home/karilla/Cours/TB/zephyr-first-step/zephyr/arch/posix/Kconfig"
osource "/home/karilla/Cours/TB/zephyr-first-step/zephyr/arch/openrisc/Kconfig"
osource "/home/karilla/Cours/TB/zephyr-first-step/zephyr/arch/mips/Kconfig"
osource "/home/karilla/Cours/TB/zephyr-first-step/zephyr/arch/arm64/Kconfig"
osource "/home/karilla/Cours/TB/zephyr-first-step/zephyr/arch/arm/Kconfig"
osource "/home/karilla/Cours/TB/zephyr-first-step/zephyr/arch/arc/Kconfig"
```

## zephyr-first-step/app_border_router/build/Kconfig/boards/Kconfig.defconfig
```kconfig
# Load Zephyr board defconfig descriptions.
osource "/home/karilla/Cours/TB/zephyr-first-step/zephyr/boards/ti/cc1352p7_launchpad/Kconfig.defconfig"
```

## zephyr-first-step/app_border_router/build/Kconfig/soc/Kconfig.defconfig
```kconfig
# Load Zephyr SoC defconfig descriptions.
osource "/home/karilla/Cours/TB/zephyr-first-step/zephyr/soc/xlnx/zynqmp/Kconfig.defconfig"
osource "/home/karilla/Cours/TB/zephyr-first-step/zephyr/soc/xlnx/zynq7000/Kconfig.defconfig"
osource "/home/karilla/Cours/TB/zephyr-first-step/zephyr/soc/xlnx/versalnet/Kconfig.defconfig"
osource "/home/karilla/Cours/TB/zephyr-first-step/zephyr/soc/xlnx/versal2/Kconfig.defconfig"
osource "/home/karilla/Cours/TB/zephyr-first-step/zephyr/soc/xlnx/versal/Kconfig.defconfig"
osource "/home/karilla/Cours/TB/zephyr-first-step/zephyr/soc/xen/Kconfig.defconfig"
osource "/home/karilla/Cours/TB/zephyr-first-step/zephyr/soc/wch/ch32v/Kconfig.defconfig"
osource "/home/karilla/Cours/TB/zephyr-first-step/zephyr/soc/ti/simplelink/Kconfig.defconfig"
osource "/home/karilla/Cours/TB/zephyr-first-step/zephyr/soc/ti/mspm0/Kconfig.defconfig"
osource "/home/karilla/Cours/TB/zephyr-first-step/zephyr/soc/ti/lm3s6965/Kconfig.defconfig"
osource "/home/karilla/Cours/TB/zephyr-first-step/zephyr/soc/ti/k3/Kconfig.defconfig"
osource "/home/karilla/Cours/TB/zephyr-first-step/zephyr/soc/telink/tlsr/Kconfig.defconfig"
osource "/home/karilla/Cours/TB/zephyr-first-step/zephyr/soc/syna/sr100/Kconfig.defconfig"
osource "/home/karilla/Cours/TB/zephyr-first-step/zephyr/soc/starfive/jh71xx/Kconfig.defconfig"
osource "/home/karilla/Cours/TB/zephyr-first-step/zephyr/soc/st/stm32/Kconfig.defconfig"
osource "/home/karilla/Cours/TB/zephyr-first-step/zephyr/soc/snps/qemu_arc/Kconfig.defconfig"
osource "/home/karilla/Cours/TB/zephyr-first-step/zephyr/soc/snps/nsim/arc_v/Kconfig.defconfig"
osource "/home/karilla/Cours/TB/zephyr-first-step/zephyr/soc/snps/nsim/arc_classic/Kconfig.defconfig"
osource "/home/karilla/Cours/TB/zephyr-first-step/zephyr/soc/snps/hsdk4xd/Kconfig.defconfig"
osource "/home/karilla/Cours/TB/zephyr-first-step/zephyr/soc/snps/hsdk/Kconfig.defconfig"
osource "/home/karilla/Cours/TB/zephyr-first-step/zephyr/soc/snps/emsk/Kconfig.defconfig"
osource "/home/karilla/Cours/TB/zephyr-first-step/zephyr/soc/snps/emsdp/Kconfig.defconfig"
osource "/home/karilla/Cours/TB/zephyr-first-step/zephyr/soc/snps/arc_iot/Kconfig.defconfig"
osource "/home/karilla/Cours/TB/zephyr-first-step/zephyr/soc/silabs/Kconfig.defconfig"
osource "/home/karilla/Cours/TB/zephyr-first-step/zephyr/soc/sifli/sf32/Kconfig.defconfig"
osource "/home/karilla/Cours/TB/zephyr-first-step/zephyr/soc/sifive/sifive_freedom/Kconfig.defconfig"
osource "/home/karilla/Cours/TB/zephyr-first-step/zephyr/soc/sensry/Kconfig.defconfig"
osource "/home/karilla/Cours/TB/zephyr-first-step/zephyr/soc/rockchip/Kconfig.defconfig"
osource "/home/karilla/Cours/TB/zephyr-first-step/zephyr/soc/renode/riscv_virtual/Kconfig.defconfig"
osource "/home/karilla/Cours/TB/zephyr-first-step/zephyr/soc/renode/cortex_r8_virtual/Kconfig.defconfig"
osource "/home/karilla/Cours/TB/zephyr-first-step/zephyr/soc/renesas/smartbond/Kconfig.defconfig"
osource "/home/karilla/Cours/TB/zephyr-first-step/zephyr/soc/renesas/rz/Kconfig.defconfig"
osource "/home/karilla/Cours/TB/zephyr-first-step/zephyr/soc/renesas/rx/Kconfig.defconfig"
osource "/home/karilla/Cours/TB/zephyr-first-step/zephyr/soc/renesas/rcar/Kconfig.defconfig"
osource "/home/karilla/Cours/TB/zephyr-first-step/zephyr/soc/renesas/ra/Kconfig.defconfig"
osource "/home/karilla/Cours/TB/zephyr-first-step/zephyr/soc/realtek/fingerprint/Kconfig.defconfig"
osource "/home/karilla/Cours/TB/zephyr-first-step/zephyr/soc/realtek/ec/Kconfig.defconfig"
osource "/home/karilla/Cours/TB/zephyr-first-step/zephyr/soc/realtek/bee/Kconfig.defconfig"
osource "/home/karilla/Cours/TB/zephyr-first-step/zephyr/soc/realtek/ameba/Kconfig.defconfig"
osource "/home/karilla/Cours/TB/zephyr-first-step/zephyr/soc/raspberrypi/rpi_pico/Kconfig.defconfig"
osource "/home/karilla/Cours/TB/zephyr-first-step/zephyr/soc/quicklogic/eos_s3/Kconfig.defconfig"
osource "/home/karilla/Cours/TB/zephyr-first-step/zephyr/soc/qemu/virt_riscv/Kconfig.defconfig"
osource "/home/karilla/Cours/TB/zephyr-first-step/zephyr/soc/qemu/or1k/Kconfig.defconfig"
osource "/home/karilla/Cours/TB/zephyr-first-step/zephyr/soc/qemu/malta/Kconfig.defconfig"
osource "/home/karilla/Cours/TB/zephyr-first-step/zephyr/soc/openisa/rv32m1/Kconfig.defconfig"
osource "/home/karilla/Cours/TB/zephyr-first-step/zephyr/soc/openhwgroup/cva6/Kconfig.defconfig"
osource "/home/karilla/Cours/TB/zephyr-first-step/zephyr/soc/oct/osd32mp15x/Kconfig.defconfig"
osource "/home/karilla/Cours/TB/zephyr-first-step/zephyr/soc/nxp/s32/Kconfig.defconfig"
osource "/home/karilla/Cours/TB/zephyr-first-step/zephyr/soc/nxp/rw/Kconfig.defconfig"
osource "/home/karilla/Cours/TB/zephyr-first-step/zephyr/soc/nxp/mcx/Kconfig.defconfig"
osource "/home/karilla/Cours/TB/zephyr-first-step/zephyr/soc/nxp/lpc/Kconfig.defconfig"
osource "/home/karilla/Cours/TB/zephyr-first-step/zephyr/soc/nxp/layerscape/Kconfig.defconfig"
osource "/home/karilla/Cours/TB/zephyr-first-step/zephyr/soc/nxp/kinetis/Kconfig.defconfig"
osource "/home/karilla/Cours/TB/zephyr-first-step/zephyr/soc/nxp/imxrt/Kconfig.defconfig"
osource "/home/karilla/Cours/TB/zephyr-first-step/zephyr/soc/nxp/imx/Kconfig.defconfig"
osource "/home/karilla/Cours/TB/zephyr-first-step/zephyr/soc/nuvoton/numicro/Kconfig.defconfig"
osource "/home/karilla/Cours/TB/zephyr-first-step/zephyr/soc/nuvoton/numaker/Kconfig.defconfig"
osource "/home/karilla/Cours/TB/zephyr-first-step/zephyr/soc/nuvoton/npcx/Kconfig.defconfig"
osource "/home/karilla/Cours/TB/zephyr-first-step/zephyr/soc/nuvoton/npcm/Kconfig.defconfig"
osource "/home/karilla/Cours/TB/zephyr-first-step/zephyr/soc/nordic/Kconfig.defconfig"
osource "/home/karilla/Cours/TB/zephyr-first-step/zephyr/soc/neorv32/Kconfig.defconfig"
osource "/home/karilla/Cours/TB/zephyr-first-step/zephyr/soc/native/inf_clock/Kconfig.defconfig"
osource "/home/karilla/Cours/TB/zephyr-first-step/zephyr/soc/microchip/sam/sama7/Kconfig.defconfig"
osource "/home/karilla/Cours/TB/zephyr-first-step/zephyr/soc/microchip/sam/sam_d5x_e5x/Kconfig.defconfig"
osource "/home/karilla/Cours/TB/zephyr-first-step/zephyr/soc/microchip/pic64/Kconfig.defconfig"
osource "/home/karilla/Cours/TB/zephyr-first-step/zephyr/soc/microchip/pic32c/pic32cz_ca/Kconfig.defconfig"
osource "/home/karilla/Cours/TB/zephyr-first-step/zephyr/soc/microchip/pic32c/pic32cx_sg/Kconfig.defconfig"
osource "/home/karilla/Cours/TB/zephyr-first-step/zephyr/soc/microchip/pic32c/pic32cm_pl/Kconfig.defconfig"
osource "/home/karilla/Cours/TB/zephyr-first-step/zephyr/soc/microchip/pic32c/pic32cm_jh/Kconfig.defconfig"
osource "/home/karilla/Cours/TB/zephyr-first-step/zephyr/soc/microchip/miv/Kconfig.defconfig"
osource "/home/karilla/Cours/TB/zephyr-first-step/zephyr/soc/microchip/mec/Kconfig.defconfig"
osource "/home/karilla/Cours/TB/zephyr-first-step/zephyr/soc/mediatek/mt8xxx/Kconfig.defconfig"
osource "/home/karilla/Cours/TB/zephyr-first-step/zephyr/soc/lowrisc/opentitan/Kconfig.defconfig"
osource "/home/karilla/Cours/TB/zephyr-first-step/zephyr/soc/litex/litex_vexriscv/Kconfig.defconfig"
osource "/home/karilla/Cours/TB/zephyr-first-step/zephyr/soc/ite/ec/Kconfig.defconfig"
osource "/home/karilla/Cours/TB/zephyr-first-step/zephyr/soc/intel/wildcat_lake/Kconfig.defconfig"
osource "/home/karilla/Cours/TB/zephyr-first-step/zephyr/soc/intel/raptor_lake/Kconfig.defconfig"
osource "/home/karilla/Cours/TB/zephyr-first-step/zephyr/soc/intel/panther_lake/Kconfig.defconfig"
osource "/home/karilla/Cours/TB/zephyr-first-step/zephyr/soc/intel/lakemont/Kconfig.defconfig"
osource "/home/karilla/Cours/TB/zephyr-first-step/zephyr/soc/intel/intel_socfpga_std/Kconfig.defconfig"
osource "/home/karilla/Cours/TB/zephyr-first-step/zephyr/soc/intel/intel_socfpga/Kconfig.defconfig"
osource "/home/karilla/Cours/TB/zephyr-first-step/zephyr/soc/intel/intel_niosv/Kconfig.defconfig"
osource "/home/karilla/Cours/TB/zephyr-first-step/zephyr/soc/intel/intel_ish/Kconfig.defconfig"
osource "/home/karilla/Cours/TB/zephyr-first-step/zephyr/soc/intel/intel_adsp/Kconfig.defconfig"
osource "/home/karilla/Cours/TB/zephyr-first-step/zephyr/soc/intel/elkhart_lake/Kconfig.defconfig"
osource "/home/karilla/Cours/TB/zephyr-first-step/zephyr/soc/intel/atom/Kconfig.defconfig"
osource "/home/karilla/Cours/TB/zephyr-first-step/zephyr/soc/intel/apollo_lake/Kconfig.defconfig"
osource "/home/karilla/Cours/TB/zephyr-first-step/zephyr/soc/intel/alder_lake/Kconfig.defconfig"
osource "/home/karilla/Cours/TB/zephyr-first-step/zephyr/soc/infineon/psoc4/Kconfig.defconfig"
osource "/home/karilla/Cours/TB/zephyr-first-step/zephyr/soc/infineon/edge/Kconfig.defconfig"
osource "/home/karilla/Cours/TB/zephyr-first-step/zephyr/soc/infineon/cat3/Kconfig.defconfig"
osource "/home/karilla/Cours/TB/zephyr-first-step/zephyr/soc/infineon/cat1c/Kconfig.defconfig"
osource "/home/karilla/Cours/TB/zephyr-first-step/zephyr/soc/infineon/cat1b/Kconfig.defconfig"
osource "/home/karilla/Cours/TB/zephyr-first-step/zephyr/soc/infineon/cat1a/Kconfig.defconfig"
osource "/home/karilla/Cours/TB/zephyr-first-step/zephyr/soc/gd/gd32/Kconfig.defconfig"
osource "/home/karilla/Cours/TB/zephyr-first-step/zephyr/soc/gaisler/leon3/Kconfig.defconfig"
osource "/home/karilla/Cours/TB/zephyr-first-step/zephyr/soc/gaisler/gr716a/Kconfig.defconfig"
osource "/home/karilla/Cours/TB/zephyr-first-step/zephyr/soc/focaltech/Kconfig.defconfig"
osource "/home/karilla/Cours/TB/zephyr-first-step/zephyr/soc/espressif/Kconfig.defconfig"
osource "/home/karilla/Cours/TB/zephyr-first-step/zephyr/soc/ene/kb1200/Kconfig.defconfig"
osource "/home/karilla/Cours/TB/zephyr-first-step/zephyr/soc/ene/kb106x/Kconfig.defconfig"
osource "/home/karilla/Cours/TB/zephyr-first-step/zephyr/soc/elan/em32f967/Kconfig.defconfig"
osource "/home/karilla/Cours/TB/zephyr-first-step/zephyr/soc/egis/Kconfig.defconfig"
osource "/home/karilla/Cours/TB/zephyr-first-step/zephyr/soc/efinix/sapphire/Kconfig.defconfig"
osource "/home/karilla/Cours/TB/zephyr-first-step/zephyr/soc/cdns/xtensa_sample_controller/Kconfig.defconfig"
osource "/home/karilla/Cours/TB/zephyr-first-step/zephyr/soc/cdns/swerv/Kconfig.defconfig"
osource "/home/karilla/Cours/TB/zephyr-first-step/zephyr/soc/cdns/sample_controller32/Kconfig.defconfig"
osource "/home/karilla/Cours/TB/zephyr-first-step/zephyr/soc/cdns/dc233c/Kconfig.defconfig"
osource "/home/karilla/Cours/TB/zephyr-first-step/zephyr/soc/brcm/bcmvk/Kconfig.defconfig"
osource "/home/karilla/Cours/TB/zephyr-first-step/zephyr/soc/brcm/bcm2712/Kconfig.defconfig"
osource "/home/karilla/Cours/TB/zephyr-first-step/zephyr/soc/brcm/bcm2711/Kconfig.defconfig"
osource "/home/karilla/Cours/TB/zephyr-first-step/zephyr/soc/blackberry/qnxhv_vm/Kconfig.defconfig"
osource "/home/karilla/Cours/TB/zephyr-first-step/zephyr/soc/bflb/Kconfig.defconfig"
osource "/home/karilla/Cours/TB/zephyr-first-step/zephyr/soc/atmel/sam0/Kconfig.defconfig"
osource "/home/karilla/Cours/TB/zephyr-first-step/zephyr/soc/atmel/sam/Kconfig.defconfig"
osource "/home/karilla/Cours/TB/zephyr-first-step/zephyr/soc/aspeed/Kconfig.defconfig"
osource "/home/karilla/Cours/TB/zephyr-first-step/zephyr/soc/arm/Kconfig.defconfig"
osource "/home/karilla/Cours/TB/zephyr-first-step/zephyr/soc/arm/beetle/Kconfig.defconfig"
osource "/home/karilla/Cours/TB/zephyr-first-step/zephyr/soc/antmicro/myra/Kconfig.defconfig"
osource "/home/karilla/Cours/TB/zephyr-first-step/zephyr/soc/andestech/Kconfig.defconfig"
osource "/home/karilla/Cours/TB/zephyr-first-step/zephyr/soc/amd/acp_6_0/Kconfig.defconfig"
osource "/home/karilla/Cours/TB/zephyr-first-step/zephyr/soc/ambiq/Kconfig.defconfig"
osource "/home/karilla/Cours/TB/zephyr-first-step/zephyr/soc/allwinner/sun8i_h3/Kconfig.defconfig"
osource "/home/karilla/Cours/TB/zephyr-first-step/zephyr/soc/alif/ensemble/Kconfig.defconfig"
osource "/home/karilla/Cours/TB/zephyr-first-step/zephyr/soc/aesc/Kconfig.defconfig"
osource "/home/karilla/Cours/TB/zephyr-first-step/zephyr/soc/adi/max32/Kconfig.defconfig"
```

## zephyr-first-step/app_device_node/build/Kconfig/boards/Kconfig
```kconfig
# Load Zephyr board Kconfig descriptions.
osource "/home/karilla/Cours/TB/zephyr-first-step/zephyr/boards/ti/cc1352p7_launchpad/Kconfig"
```

## zephyr-first-step/app_ethernet/build/Kconfig/boards/Kconfig
```kconfig
# Load Zephyr board Kconfig descriptions.
osource "/home/karilla/Cours/TB/zephyr-first-step/zephyr/boards/st/stm32f769i_disco/Kconfig"
```

## zephyr-first-step/app_ethernet/build/Kconfig/boards/Kconfig.defconfig
```kconfig
# Load Zephyr board defconfig descriptions.
osource "/home/karilla/Cours/TB/zephyr-first-step/zephyr/boards/st/stm32f769i_disco/Kconfig.defconfig"
```
