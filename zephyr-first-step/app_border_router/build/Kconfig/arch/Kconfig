## zephyr-first-step/app_ethernet/build/Kconfig/soc/Kconfig.soc.tmp
```kconfig
# Load SoC Kconfig descriptions.
osource "/home/karilla/Cours/TB/zephyr-first-step/zephyr/soc/xlnx/zynqmp/Kconfig.soc"
osource "/home/karilla/Cours/TB/zephyr-first-step/zephyr/soc/xlnx/zynq7000/Kconfig.soc"
osource "/home/karilla/Cours/TB/zephyr-first-step/zephyr/soc/xlnx/versalnet/Kconfig.soc"
osource "/home/karilla/Cours/TB/zephyr-first-step/zephyr/soc/xlnx/versal2/Kconfig.soc"
osource "/home/karilla/Cours/TB/zephyr-first-step/zephyr/soc/xlnx/versal/Kconfig.soc"
osource "/home/karilla/Cours/TB/zephyr-first-step/zephyr/soc/xen/Kconfig.soc"
osource "/home/karilla/Cours/TB/zephyr-first-step/zephyr/soc/wch/ch32v/Kconfig.soc"
osource "/home/karilla/Cours/TB/zephyr-first-step/zephyr/soc/ti/simplelink/Kconfig.soc"
osource "/home/karilla/Cours/TB/zephyr-first-step/zephyr/soc/ti/mspm0/Kconfig.soc"
osource "/home/karilla/Cours/TB/zephyr-first-step/zephyr/soc/ti/lm3s6965/Kconfig.soc"
osource "/home/karilla/Cours/TB/zephyr-first-step/zephyr/soc/ti/k3/Kconfig.soc"
osource "/home/karilla/Cours/TB/zephyr-first-step/zephyr/soc/telink/tlsr/Kconfig.soc"
osource "/home/karilla/Cours/TB/zephyr-first-step/zephyr/soc/syna/sr100/Kconfig.soc"
osource "/home/karilla/Cours/TB/zephyr-first-step/zephyr/soc/starfive/jh71xx/Kconfig.soc"
osource "/home/karilla/Cours/TB/zephyr-first-step/zephyr/soc/st/stm32/Kconfig.soc"
osource "/home/karilla/Cours/TB/zephyr-first-step/zephyr/soc/snps/qemu_arc/Kconfig.soc"
osource "/home/karilla/Cours/TB/zephyr-first-step/zephyr/soc/snps/nsim/arc_v/Kconfig.soc"
osource "/home/karilla/Cours/TB/zephyr-first-step/zephyr/soc/snps/nsim/arc_classic/Kconfig.soc"
osource "/home/karilla/Cours/TB/zephyr-first-step/zephyr/soc/snps/hsdk4xd/Kconfig.soc"
osource "/home/karilla/Cours/TB/zephyr-first-step/zephyr/soc/snps/hsdk/Kconfig.soc"
osource "/home/karilla/Cours/TB/zephyr-first-step/zephyr/soc/snps/emsk/Kconfig.soc"
osource "/home/karilla/Cours/TB/zephyr-first-step/zephyr/soc/snps/emsdp/Kconfig.soc"
osource "/home/karilla/Cours/TB/zephyr-first-step/zephyr/soc/snps/arc_iot/Kconfig.soc"
osource "/home/karilla/Cours/TB/zephyr-first-step/zephyr/soc/silabs/Kconfig.soc"
osource "/home/karilla/Cours/TB/zephyr-first-step/zephyr/soc/sifli/sf32/Kconfig.soc"
osource "/home/karilla/Cours/TB/zephyr-first-step/zephyr/soc/sifive/sifive_freedom/Kconfig.soc"
osource "/home/karilla/Cours/TB/zephyr-first-step/zephyr/soc/sensry/Kconfig.soc"
osource "/home/karilla/Cours/TB/zephyr-first-step/zephyr/soc/rockchip/Kconfig.soc"
osource "/home/karilla/Cours/TB/zephyr-first-step/zephyr/soc/renode/riscv_virtual/Kconfig.soc"
osource "/home/karilla/Cours/TB/zephyr-first-step/zephyr/soc/renode/cortex_r8_virtual/Kconfig.soc"
osource "/home/karilla/Cours/TB/zephyr-first-step/zephyr/soc/renesas/smartbond/Kconfig.soc"
osource "/home/karilla/Cours/TB/zephyr-first-step/zephyr/soc/renesas/rz/Kconfig.soc"
osource "/home/karilla/Cours/TB/zephyr-first-step/zephyr/soc/renesas/rx/Kconfig.soc"
osource "/home/karilla/Cours/TB/zephyr-first-step/zephyr/soc/renesas/rcar/Kconfig.soc"
osource "/home/karilla/Cours/TB/zephyr-first-step/zephyr/soc/renesas/ra/Kconfig.soc"
osource "/home/karilla/Cours/TB/zephyr-first-step/zephyr/soc/realtek/fingerprint/Kconfig.soc"
osource "/home/karilla/Cours/TB/zephyr-first-step/zephyr/soc/realtek/ec/Kconfig.soc"
osource "/home/karilla/Cours/TB/zephyr-first-step/zephyr/soc/realtek/bee/Kconfig.soc"
osource "/home/karilla/Cours/TB/zephyr-first-step/zephyr/soc/realtek/ameba/Kconfig.soc"
osource "/home/karilla/Cours/TB/zephyr-first-step/zephyr/soc/raspberrypi/rpi_pico/Kconfig.soc"
osource "/home/karilla/Cours/TB/zephyr-first-step/zephyr/soc/quicklogic/eos_s3/Kconfig.soc"
osource "/home/karilla/Cours/TB/zephyr-first-step/zephyr/soc/qemu/virt_riscv/Kconfig.soc"
osource "/home/karilla/Cours/TB/zephyr-first-step/zephyr/soc/qemu/or1k/Kconfig.soc"
osource "/home/karilla/Cours/TB/zephyr-first-step/zephyr/soc/qemu/malta/Kconfig.soc"
osource "/home/karilla/Cours/TB/zephyr-first-step/zephyr/soc/openisa/rv32m1/Kconfig.soc"
osource "/home/karilla/Cours/TB/zephyr-first-step/zephyr/soc/openhwgroup/cva6/Kconfig.soc"
osource "/home/karilla/Cours/TB/zephyr-first-step/zephyr/soc/oct/osd32mp15x/Kconfig.soc"
osource "/home/karilla/Cours/TB/zephyr-first-step/zephyr/soc/nxp/s32/Kconfig.soc"
osource "/home/karilla/Cours/TB/zephyr-first-step/zephyr/soc/nxp/rw/Kconfig.soc"
osource "/home/karilla/Cours/TB/zephyr-first-step/zephyr/soc/nxp/mcx/Kconfig.soc"
osource "/home/karilla/Cours/TB/zephyr-first-step/zephyr/soc/nxp/lpc/Kconfig.soc"
osource "/home/karilla/Cours/TB/zephyr-first-step/zephyr/soc/nxp/layerscape/Kconfig.soc"
osource "/home/karilla/Cours/TB/zephyr-first-step/zephyr/soc/nxp/kinetis/Kconfig.soc"
osource "/home/karilla/Cours/TB/zephyr-first-step/zephyr/soc/nxp/imxrt/Kconfig.soc"
osource "/home/karilla/Cours/TB/zephyr-first-step/zephyr/soc/nxp/imx/Kconfig.soc"
osource "/home/karilla/Cours/TB/zephyr-first-step/zephyr/soc/nuvoton/numicro/Kconfig.soc"
osource "/home/karilla/Cours/TB/zephyr-first-step/zephyr/soc/nuvoton/numaker/Kconfig.soc"
osource "/home/karilla/Cours/TB/zephyr-first-step/zephyr/soc/nuvoton/npcx/Kconfig.soc"
osource "/home/karilla/Cours/TB/zephyr-first-step/zephyr/soc/nuvoton/npcm/Kconfig.soc"
osource "/home/karilla/Cours/TB/zephyr-first-step/zephyr/soc/nordic/Kconfig.soc"
osource "/home/karilla/Cours/TB/zephyr-first-step/zephyr/soc/neorv32/Kconfig.soc"
osource "/home/karilla/Cours/TB/zephyr-first-step/zephyr/soc/native/inf_clock/Kconfig.soc"
osource "/home/karilla/Cours/TB/zephyr-first-step/zephyr/soc/microchip/sam/sama7/Kconfig.soc"
osource "/home/karilla/Cours/TB/zephyr-first-step/zephyr/soc/microchip/sam/sam_d5x_e5x/Kconfig.soc"
osource "/home/karilla/Cours/TB/zephyr-first-step/zephyr/soc/microchip/pic64/Kconfig.soc"
osource "/home/karilla/Cours/TB/zephyr-first-step/zephyr/soc/microchip/pic32c/pic32cz_ca/Kconfig.soc"
osource "/home/karilla/Cours/TB/zephyr-first-step/zephyr/soc/microchip/pic32c/pic32cx_sg/Kconfig.soc"
osource "/home/karilla/Cours/TB/zephyr-first-step/zephyr/soc/microchip/pic32c/pic32cm_pl/Kconfig.soc"
osource "/home/karilla/Cours/TB/zephyr-first-step/zephyr/soc/microchip/pic32c/pic32cm_jh/Kconfig.soc"
osource "/home/karilla/Cours/TB/zephyr-first-step/zephyr/soc/microchip/miv/Kconfig.soc"
osource "/home/karilla/Cours/TB/zephyr-first-step/zephyr/soc/microchip/mec/Kconfig.soc"
osource "/home/karilla/Cours/TB/zephyr-first-step/zephyr/soc/mediatek/mt8xxx/Kconfig.soc"
osource "/home/karilla/Cours/TB/zephyr-first-step/zephyr/soc/lowrisc/opentitan/Kconfig.soc"
osource "/home/karilla/Cours/TB/zephyr-first-step/zephyr/soc/litex/litex_vexriscv/Kconfig.soc"
osource "/home/karilla/Cours/TB/zephyr-first-step/zephyr/soc/ite/ec/Kconfig.soc"
osource "/home/karilla/Cours/TB/zephyr-first-step/zephyr/soc/intel/wildcat_lake/Kconfig.soc"
osource "/home/karilla/Cours/TB/zephyr-first-step/zephyr/soc/intel/raptor_lake/Kconfig.soc"
osource "/home/karilla/Cours/TB/zephyr-first-step/zephyr/soc/intel/panther_lake/Kconfig.soc"
osource "/home/karilla/Cours/TB/zephyr-first-step/zephyr/soc/intel/lakemont/Kconfig.soc"
osource "/home/karilla/Cours/TB/zephyr-first-step/zephyr/soc/intel/intel_socfpga_std/Kconfig.soc"
osource "/home/karilla/Cours/TB/zephyr-first-step/zephyr/soc/intel/intel_socfpga/Kconfig.soc"
osource "/home/karilla/Cours/TB/zephyr-first-step/zephyr/soc/intel/intel_niosv/Kconfig.soc"
osource "/home/karilla/Cours/TB/zephyr-first-step/zephyr/soc/intel/intel_ish/Kconfig.soc"
osource "/home/karilla/Cours/TB/zephyr-first-step/zephyr/soc/intel/intel_adsp/Kconfig.soc"
osource "/home/karilla/Cours/TB/zephyr-first-step/zephyr/soc/intel/elkhart_lake/Kconfig.soc"
osource "/home/karilla/Cours/TB/zephyr-first-step/zephyr/soc/intel/atom/Kconfig.soc"
osource "/home/karilla/Cours/TB/zephyr-first-step/zephyr/soc/intel/apollo_lake/Kconfig.soc"
osource "/home/karilla/Cours/TB/zephyr-first-step/zephyr/soc/intel/alder_lake/Kconfig.soc"
osource "/home/karilla/Cours/TB/zephyr-first-step/zephyr/soc/infineon/psoc4/Kconfig.soc"
osource "/home/karilla/Cours/TB/zephyr-first-step/zephyr/soc/infineon/edge/Kconfig.soc"
osource "/home/karilla/Cours/TB/zephyr-first-step/zephyr/soc/infineon/cat3/Kconfig.soc"
osource "/home/karilla/Cours/TB/zephyr-first-step/zephyr/soc/infineon/cat1c/Kconfig.soc"
osource "/home/karilla/Cours/TB/zephyr-first-step/zephyr/soc/infineon/cat1b/Kconfig.soc"
osource "/home/karilla/Cours/TB/zephyr-first-step/zephyr/soc/infineon/cat1a/Kconfig.soc"
osource "/home/karilla/Cours/TB/zephyr-first-step/zephyr/soc/gd/gd32/Kconfig.soc"
osource "/home/karilla/Cours/TB/zephyr-first-step/zephyr/soc/gaisler/leon3/Kconfig.soc"
osource "/home/karilla/Cours/TB/zephyr-first-step/zephyr/soc/gaisler/gr716a/Kconfig.soc"
osource "/home/karilla/Cours/TB/zephyr-first-step/zephyr/soc/focaltech/Kconfig.soc"
osource "/home/karilla/Cours/TB/zephyr-first-step/zephyr/soc/espressif/Kconfig.soc"
osource "/home/karilla/Cours/TB/zephyr-first-step/zephyr/soc/ene/kb1200/Kconfig.soc"
osource "/home/karilla/Cours/TB/zephyr-first-step/zephyr/soc/ene/kb106x/Kconfig.soc"
osource "/home/karilla/Cours/TB/zephyr-first-step/zephyr/soc/elan/em32f967/Kconfig.soc"
osource "/home/karilla/Cours/TB/zephyr-first-step/zephyr/soc/egis/Kconfig.soc"
osource "/home/karilla/Cours/TB/zephyr-first-step/zephyr/soc/efinix/sapphire/Kconfig.soc"
osource "/home/karilla/Cours/TB/zephyr-first-step/zephyr/soc/cdns/xtensa_sample_controller/Kconfig.soc"
osource "/home/karilla/Cours/TB/zephyr-first-step/zephyr/soc/cdns/swerv/Kconfig.soc"
osource "/home/karilla/Cours/TB/zephyr-first-step/zephyr/soc/cdns/sample_controller32/Kconfig.soc"
osource "/home/karilla/Cours/TB/zephyr-first-step/zephyr/soc/cdns/dc233c/Kconfig.soc"
osource "/home/karilla/Cours/TB/zephyr-first-step/zephyr/soc/brcm/bcmvk/Kconfig.soc"
osource "/home/karilla/Cours/TB/zephyr-first-step/zephyr/soc/brcm/bcm2712/Kconfig.soc"
osource "/home/karilla/Cours/TB/zephyr-first-step/zephyr/soc/brcm/bcm2711/Kconfig.soc"
osource "/home/karilla/Cours/TB/zephyr-first-step/zephyr/soc/blackberry/qnxhv_vm/Kconfig.soc"
osource "/home/karilla/Cours/TB/zephyr-first-step/zephyr/soc/bflb/Kconfig.soc"
osource "/home/karilla/Cours/TB/zephyr-first-step/zephyr/soc/atmel/sam0/Kconfig.soc"
osource "/home/karilla/Cours/TB/zephyr-first-step/zephyr/soc/atmel/sam/Kconfig.soc"
osource "/home/karilla/Cours/TB/zephyr-first-step/zephyr/soc/aspeed/Kconfig.soc"
osource "/home/karilla/Cours/TB/zephyr-first-step/zephyr/soc/arm/Kconfig.soc"
osource "/home/karilla/Cours/TB/zephyr-first-step/zephyr/soc/arm/beetle/Kconfig.soc"
osource "/home/karilla/Cours/TB/zephyr-first-step/zephyr/soc/antmicro/myra/Kconfig.soc"
osource "/home/karilla/Cours/TB/zephyr-first-step/zephyr/soc/andestech/Kconfig.soc"
osource "/home/karilla/Cours/TB/zephyr-first-step/zephyr/soc/amd/acp_6_0/Kconfig.soc"
osource "/home/karilla/Cours/TB/zephyr-first-step/zephyr/soc/ambiq/Kconfig.soc"
osource "/home/karilla/Cours/TB/zephyr-first-step/zephyr/soc/allwinner/sun8i_h3/Kconfig.soc"
osource "/home/karilla/Cours/TB/zephyr-first-step/zephyr/soc/alif/ensemble/Kconfig.soc"
osource "/home/karilla/Cours/TB/zephyr-first-step/zephyr/soc/aesc/Kconfig.soc"
osource "/home/karilla/Cours/TB/zephyr-first-step/zephyr/soc/adi/max32/Kconfig.soc"
```
